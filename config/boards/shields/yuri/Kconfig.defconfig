## config/boards/shields/yuri/Kconfig.defconfig
```kconfig
# Copyright (c) 2021 purple-rw
# SPDX-License-Identifier: MIT

if SHIELD_YURI

config ZMK_KEYBOARD_NAME
    default "Yuri"

endif
```

## config/boards/shields/yuri/Kconfig.shield
```kconfig
# Copyright (c) 2021 purple-rw
# SPDX-License-Identifier: MIT

config SHIELD_Yuri
    def_bool $(shields_list_contains,yuri)
```
